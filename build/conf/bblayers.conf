## build/conf/bblayers.conf
```bitbake
# POKY_BBLAYERS_CONF_VERSION is increased each time build/conf/bblayers.conf
# changes incompatibly
POKY_BBLAYERS_CONF_VERSION = "2"

BBPATH = "${TOPDIR}"
BBFILES ?= ""

BBLAYERS ?= " \
  ../layers/poky/meta \
  ../layers/poky/meta-poky \
  ../layers/poky/meta-yocto-bsp \
  ../layers/meta-openembedded/meta-oe \
  ../layers/meta-openembedded/meta-multimedia \
  ../layers/meta-openembedded/meta-networking \
  ../layers/meta-openembedded/meta-python \
  ../layers/meta-sunxi \
  "
```
